## conf/distro/booklore.conf
```bitbake
DISTRO = "booklore"
DISTRO_NAME = "BookLore E-Reader OS"
DISTRO_VERSION = "0.1.0"

VIRTUAL-RUNTIME_init_manager = "sysvinit"
VIRTUAL-RUNTIME_initscripts = "initscripts"

DISTRO_FEATURES = "wifi usbhost usbgadget ipv4 ipv6"
DISTRO_FEATURES:remove = "x11 wayland opengl vulkan pulseaudio bluetooth nfc 3g"

PACKAGE_CLASSES = "package_ipk"

IMAGE_LINGUAS = "en-us"
```

## conf/layer.conf
```bitbake
# We have a conf and classes directory, add to BBPATH
BBPATH .= ":${LAYERDIR}"

# We have recipes-* directories, add to BBFILES
BBFILES += "${LAYERDIR}/recipes-*/*/*.bb \
            ${LAYERDIR}/recipes-*/*/*.bbappend"

BBFILE_COLLECTIONS += "meta-booklore"
BBFILE_PATTERN_meta-booklore = "^${LAYERDIR}/"
BBFILE_PRIORITY_meta-booklore = "6"

LAYERDEPENDS_meta-booklore = "core"
LAYERSERIES_COMPAT_meta-booklore = "kirkstone"
```
